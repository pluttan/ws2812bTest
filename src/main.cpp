/**
 * WS2812B Universal Test Suite
 * 
 * Универсальный набор тестов для проверки светодиодной ленты WS2812B
 * Включает тесты цветов, яркости, адресации и различные эффекты
 * 
 * Автор: Generated by Antigravity AI
 */

#include <Arduino.h>
#include <FastLED.h>
#include "config.h"

CRGB leds[NUM_LEDS];

// Прототипы функций тестов
void testSolid(CRGB color, const char* name);
void testRGB();
void testWhite();
void testBrightness();
void testAddressing();
void testRainbow();
void testChase();
void testFade();
void testSparkle();
void testComet();
void testBreathing();
void testGradient();
void testStrobe();
void testTheaterChase();

// Вспомогательные функции
void clearAll();
void showAndDelay(int ms = ANIMATION_DELAY);
void printTest(const char* name);

void setup() {
    #if SERIAL_DEBUG
    Serial.begin(115200);
    delay(1000);
    Serial.println();
    Serial.println("========================================");
    Serial.println("   WS2812B Universal Test Suite");
    Serial.println("========================================");
    Serial.print("LED Count: ");
    Serial.println(NUM_LEDS);
    Serial.print("Data Pin: ");
    Serial.println(DATA_PIN);
    Serial.print("Max Brightness: ");
    Serial.println(MAX_BRIGHTNESS);
    Serial.println("========================================");
    Serial.println();
    #endif

    // Инициализация FastLED
    FastLED.addLeds<LED_TYPE, DATA_PIN, COLOR_ORDER>(leds, NUM_LEDS);
    FastLED.setBrightness(MAX_BRIGHTNESS);
    FastLED.clear();
    FastLED.show();
    
    delay(500);
}

void loop() {
    // ========================================
    // БАЗОВЫЕ ТЕСТЫ ЦВЕТОВ
    // ========================================
    
    // Тест основных цветов
    testSolid(CRGB::Red, "RED");
    testSolid(CRGB::Green, "GREEN");
    testSolid(CRGB::Blue, "BLUE");
    
    // Тест RGB последовательно
    testRGB();
    
    // Тест белого цвета
    testWhite();
    
    // ========================================
    // ТЕСТЫ ЯРКОСТИ И АДРЕСАЦИИ
    // ========================================
    
    testBrightness();
    testAddressing();
    
    // ========================================
    // АНИМАЦИОННЫЕ ЭФФЕКТЫ
    // ========================================
    
    testRainbow();
    testChase();
    testFade();
    testSparkle();
    testComet();
    testBreathing();
    testGradient();
    testStrobe();
    testTheaterChase();
    
    #if SERIAL_DEBUG
    Serial.println();
    Serial.println("=== ЦИКЛ ТЕСТОВ ЗАВЕРШЕН ===");
    Serial.println("Перезапуск через 2 секунды...");
    Serial.println();
    #endif
    
    clearAll();
    delay(2000);
}

// ============================================
// РЕАЛИЗАЦИЯ ТЕСТОВ
// ============================================

void printTest(const char* name) {
    #if SERIAL_DEBUG
    Serial.print("[TEST] ");
    Serial.println(name);
    #endif
}

void clearAll() {
    FastLED.clear();
    FastLED.show();
}

void showAndDelay(int ms) {
    FastLED.show();
    delay(ms);
}

/**
 * Тест: Заливка одним цветом
 */
void testSolid(CRGB color, const char* name) {
    printTest(name);
    fill_solid(leds, NUM_LEDS, color);
    FastLED.show();
    delay(TEST_DURATION / 3);
    clearAll();
    delay(200);
}

/**
 * Тест: RGB последовательно по всей ленте
 */
void testRGB() {
    printTest("RGB Sequential");
    
    for (int cycle = 0; cycle < 3; cycle++) {
        // Красный
        fill_solid(leds, NUM_LEDS, CRGB::Red);
        FastLED.show();
        delay(500);
        
        // Зеленый
        fill_solid(leds, NUM_LEDS, CRGB::Green);
        FastLED.show();
        delay(500);
        
        // Синий
        fill_solid(leds, NUM_LEDS, CRGB::Blue);
        FastLED.show();
        delay(500);
    }
    
    clearAll();
    delay(200);
}

/**
 * Тест: Белый цвет (проверка всех каналов одновременно)
 */
void testWhite() {
    printTest("White Balance");
    
    // Холодный белый
    fill_solid(leds, NUM_LEDS, CRGB(255, 255, 255));
    FastLED.show();
    delay(1500);
    
    // Теплый белый
    fill_solid(leds, NUM_LEDS, CRGB(255, 200, 150));
    FastLED.show();
    delay(1500);
    
    clearAll();
    delay(200);
}

/**
 * Тест: Уровни яркости
 */
void testBrightness() {
    printTest("Brightness Levels");
    
    fill_solid(leds, NUM_LEDS, CRGB::White);
    
    // Плавное увеличение яркости
    for (int b = 0; b <= MAX_BRIGHTNESS; b += 5) {
        FastLED.setBrightness(b);
        FastLED.show();
        delay(30);
    }
    
    // Плавное уменьшение яркости
    for (int b = MAX_BRIGHTNESS; b >= 0; b -= 5) {
        FastLED.setBrightness(b);
        FastLED.show();
        delay(30);
    }
    
    FastLED.setBrightness(MAX_BRIGHTNESS);
    clearAll();
    delay(200);
}

/**
 * Тест: Проверка адресации каждого светодиода
 */
void testAddressing() {
    printTest("LED Addressing");
    
    // Бегущий огонь вперед
    for (int i = 0; i < NUM_LEDS; i++) {
        clearAll();
        leds[i] = CRGB::Cyan;
        FastLED.show();
        delay(50);
    }
    
    // Бегущий огонь назад
    for (int i = NUM_LEDS - 1; i >= 0; i--) {
        clearAll();
        leds[i] = CRGB::Magenta;
        FastLED.show();
        delay(50);
    }
    
    // Заполнение от начала
    clearAll();
    for (int i = 0; i < NUM_LEDS; i++) {
        leds[i] = CRGB::Yellow;
        FastLED.show();
        delay(30);
    }
    
    delay(500);
    clearAll();
    delay(200);
}

/**
 * Эффект: Радуга
 */
void testRainbow() {
    printTest("Rainbow Effect");
    
    unsigned long startTime = millis();
    while (millis() - startTime < TEST_DURATION) {
        static uint8_t hue = 0;
        fill_rainbow(leds, NUM_LEDS, hue++, 7);
        FastLED.show();
        delay(20);
    }
    
    clearAll();
    delay(200);
}

/**
 * Эффект: Бегущие огни
 */
void testChase() {
    printTest("Chase Effect");
    
    unsigned long startTime = millis();
    int pos = 0;
    
    while (millis() - startTime < TEST_DURATION) {
        fadeToBlackBy(leds, NUM_LEDS, 50);
        
        leds[pos] = CRGB::Red;
        if (pos + 1 < NUM_LEDS) leds[pos + 1] = CRGB::Orange;
        if (pos + 2 < NUM_LEDS) leds[pos + 2] = CRGB::Yellow;
        
        FastLED.show();
        delay(ANIMATION_DELAY);
        
        pos = (pos + 1) % NUM_LEDS;
    }
    
    clearAll();
    delay(200);
}

/**
 * Эффект: Плавное угасание
 */
void testFade() {
    printTest("Fade Effect");
    
    CRGB colors[] = {CRGB::Red, CRGB::Green, CRGB::Blue, CRGB::Purple};
    int numColors = sizeof(colors) / sizeof(colors[0]);
    
    for (int c = 0; c < numColors; c++) {
        // Fade in
        for (int brightness = 0; brightness < 256; brightness += 5) {
            fill_solid(leds, NUM_LEDS, colors[c]);
            nscale8(leds, NUM_LEDS, brightness);
            FastLED.show();
            delay(10);
        }
        
        // Fade out
        for (int brightness = 255; brightness >= 0; brightness -= 5) {
            fill_solid(leds, NUM_LEDS, colors[c]);
            nscale8(leds, NUM_LEDS, brightness);
            FastLED.show();
            delay(10);
        }
    }
    
    clearAll();
    delay(200);
}

/**
 * Эффект: Искры
 */
void testSparkle() {
    printTest("Sparkle Effect");
    
    unsigned long startTime = millis();
    
    while (millis() - startTime < TEST_DURATION) {
        fadeToBlackBy(leds, NUM_LEDS, 30);
        
        int pos = random16(NUM_LEDS);
        leds[pos] = CRGB::White;
        
        FastLED.show();
        delay(ANIMATION_DELAY);
    }
    
    clearAll();
    delay(200);
}

/**
 * Эффект: Комета
 */
void testComet() {
    printTest("Comet Effect");
    
    unsigned long startTime = millis();
    int pos = 0;
    bool forward = true;
    
    while (millis() - startTime < TEST_DURATION) {
        fadeToBlackBy(leds, NUM_LEDS, 40);
        
        leds[pos] = CRGB::Aqua;
        
        FastLED.show();
        delay(30);
        
        if (forward) {
            pos++;
            if (pos >= NUM_LEDS) {
                pos = NUM_LEDS - 1;
                forward = false;
            }
        } else {
            pos--;
            if (pos < 0) {
                pos = 0;
                forward = true;
            }
        }
    }
    
    clearAll();
    delay(200);
}

/**
 * Эффект: Дыхание
 */
void testBreathing() {
    printTest("Breathing Effect");
    
    unsigned long startTime = millis();
    
    while (millis() - startTime < TEST_DURATION) {
        // Используем синусоидальную функцию для плавности
        float breath = (exp(sin(millis() / 2000.0 * PI)) - 0.36787944) * 108.0;
        breath = constrain(breath, 0, MAX_BRIGHTNESS);
        
        fill_solid(leds, NUM_LEDS, CRGB::DeepSkyBlue);
        FastLED.setBrightness((uint8_t)breath);
        FastLED.show();
        delay(10);
    }
    
    FastLED.setBrightness(MAX_BRIGHTNESS);
    clearAll();
    delay(200);
}

/**
 * Эффект: Градиент
 */
void testGradient() {
    printTest("Gradient Effect");
    
    unsigned long startTime = millis();
    uint8_t offset = 0;
    
    while (millis() - startTime < TEST_DURATION) {
        for (int i = 0; i < NUM_LEDS; i++) {
            leds[i] = CHSV((offset + i * 255 / NUM_LEDS) % 256, 255, 255);
        }
        
        FastLED.show();
        delay(50);
        offset++;
    }
    
    clearAll();
    delay(200);
}

/**
 * Эффект: Стробоскоп
 */
void testStrobe() {
    printTest("Strobe Effect");
    
    for (int i = 0; i < 30; i++) {
        fill_solid(leds, NUM_LEDS, CRGB::White);
        FastLED.show();
        delay(50);
        
        clearAll();
        delay(50);
    }
    
    delay(200);
}

/**
 * Эффект: Театральная погоня
 */
void testTheaterChase() {
    printTest("Theater Chase");
    
    unsigned long startTime = millis();
    uint8_t hue = 0;
    
    while (millis() - startTime < TEST_DURATION) {
        for (int j = 0; j < 3; j++) {
            if (millis() - startTime >= TEST_DURATION) break;
            
            clearAll();
            for (int i = j; i < NUM_LEDS; i += 3) {
                leds[i] = CHSV(hue, 255, 255);
            }
            hue++;
            
            FastLED.show();
            delay(80);
        }
    }
    
    clearAll();
    delay(200);
}
